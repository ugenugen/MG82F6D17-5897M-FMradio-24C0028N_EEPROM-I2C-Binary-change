#include <Wire.h>

const byte EEPROM_I2C_ADDRESS = 0x50; // 24C02 I2Cアドレス
const int EEPROM_SIZE = 256;

const byte eepromData[EEPROM_SIZE] = {
  0xA5, 0xEC, 0x22, 0x00, 0x0A, 0x00, 0xFF, 0x01, 0x88, 0x13, 0x30, 0x2A, 0xFF, 0xFF, 0xFF, 0xFF,
  //0x01 and 0x02 : shart fx(MHz) HEX(22EC)=Dec(8940) mean 89.4MHz 0x04:number of ch
  //0x08 and 0x09 : min fx(MHz) HEX(1388)=Dec(5000)  0x0A and 0x0B : max fx(MHz) HEX(2A30)=Dec(10800)
  0x01, 0x00, 0x22, 0x1F, 0x02, 0x00, 0x58, 0x20, 0x03, 0x00, 0x02, 0x21, 0x04, 0x00, 0xFC, 0x21,
  //ch1 HEX(1F22)=Dec(7970) ch2 HEX(2058)=Dec(8280) ch3 HEX(2102)=Dec(8450) ch4 HEX(21FC)=Dec(8700)
  0x05, 0x00, 0xB0, 0x22, 0x06, 0x00, 0xEC, 0x22, 0x07, 0x00, 0x64, 0x23, 0x08, 0x00, 0xE6, 0x23,
  0x09, 0x00, 0x72, 0x24, 0x0A, 0x00, 0x12, 0x25, 0xFF, 0xFF, 0xFF, 0xFF, 0xFF, 0xFF, 0xFF, 0xFF,
  0xFF, 0xFF, 0xFF, 0xFF, 0xFF, 0xFF, 0xFF, 0xFF, 0xFF, 0xFF, 0xFF, 0xFF, 0xFF, 0xFF, 0xFF, 0xFF,
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  0xFF, 0xFF, 0xFF, 0xFF, 0xFF, 0xFF, 0xFF, 0xFF, 0xFF, 0xFF, 0xFF, 0xFF, 0xFF, 0xFF, 0xFF, 0xFF
};

bool hasWritten = false;

void setup() {
  Serial.begin(9600);
  Wire.begin();
  delay(100);
}

void loop() {
  if (!hasWritten) {
    Serial.println("EEPROMにデータ書き込み中...");
    for (int i = 0; i < EEPROM_SIZE; i++) {
      writeEEPROM((byte)i, eepromData[i]);
      delay(5); // 書き込み待ち時間
    }
    Serial.println("書き込み完了！\n");

    delay(100); // 書き込み安定化待ち

    Serial.println("書き込まれたEEPROMの内容をダンプ:");
    dumpEEPROM();

    hasWritten = true; // 1回だけ実行
  }
}

void writeEEPROM(byte address, byte data) {
  Wire.beginTransmission(EEPROM_I2C_ADDRESS);
  Wire.write(address);
  Wire.write(data);
  Wire.endTransmission();
}

byte readEEPROM(byte address) {
  Wire.beginTransmission(EEPROM_I2C_ADDRESS);
  Wire.write(address);
  Wire.endTransmission();

  Wire.requestFrom(EEPROM_I2C_ADDRESS, (byte)1);
  if (Wire.available()) {
    return Wire.read();
  } else {
    return 0xFF;
  }
}

void dumpEEPROM() {
  for (int baseAddr = 0x00; baseAddr < EEPROM_SIZE; baseAddr += 0x10) {
    Serial.print("0x");
    if (baseAddr < 0x10) Serial.print("0");
    Serial.print(baseAddr, HEX);
    Serial.print(": ");

    for (int offset = 0; offset < 0x10; offset++) {
      byte data = readEEPROM(baseAddr + offset);
      if (data < 0x10) Serial.print("0");
      Serial.print(data, HEX);
      Serial.print(" ");
    }
    Serial.println();
  }
}
